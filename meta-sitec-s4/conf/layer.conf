## meta-sitec-s4/conf/layer.conf
```bitbake
# We have a conf and classes directory, add to BBPATH
BBPATH .= ":${LAYERDIR}"

# We have recipes-* directories, add to BBFILES
BBFILES += "${LAYERDIR}/recipes-*/*/*.bb \
${LAYERDIR}/recipes-*/*/*.bbappend"

BBFILE_COLLECTIONS += "sitec-s4"
BBFILE_PATTERN_sitec-s4 = "^${LAYERDIR}/"
BBFILE_PRIORITY_sitec-s4 = "10"
LAYERVERSION_sitec-s4 = "1"
```

## meta-sitec-s4/conf/machine/include/score-base.inc
```bitbake
SERIAL_CONSOLE = "115200 ttymxc0"
SOC_FAMILY = "mx6:mx6sx"
DEFAULTTUNE_mx6sx ?= "cortexa9hf-neon"

KERNEL_IMAGETYPE = "uImage"
UBOOT_CONFIG[score] = "score_config"

IMAGE_FSTYPES += "tar.bz2"

PREFERRED_PROVIDER_virtual/kernel_mx6 = "linux-sitec"
PREFERRED_VERSION_linux-sitec = "4.1.15"
PREFERRED_PROVIDER_u-boot = "u-boot-imx"
PREFERRED_VERSION_u-boot-imx_mx6 = "2015.04"
PREFERRED_VERSION_linux-libc-headers = "4.1"

UBOOT_ENTRYPOINT_mx6sx = "0x80008000"
```

## meta-sitec-s4/conf/machine/s4-rt.conf
```bitbake
#@TYPE: Machine
#@NAME: s4
#@SOC: i.MX6SX
#@DESCRIPTION: Machine configuration for sitec systems S4
#@MAINTAINER: Robert Lehmann <robert.lehmann@sitec-systems.de>

require conf/machine/include/imx-base.inc
require conf/machine/include/tune-cortexa9.inc
require conf/machine/include/score-base.inc

KERNEL_DEVICETREE = "imx6sx-score.dtb \
	imx6sx-s4.dtb"

UBOOT_CONFIG ??= "score"

PREFERRED_PROVIDER_virtual/kernel_mx6 = "linux-sitec-rt"
PREFERRED_PROVIDER_u-boot = "u-boot-imx"
PREFERRED_PROVIDER_virtual/bootloader = "u-boot-imx"
PREFERRED_VERSION_u-boot-imx_mx6 = "2015.04"
```

## meta-sitec-s4/conf/machine/s4.conf
```bitbake
#@TYPE: Machine
#@NAME: s4
#@SOC: i.MX6SX
#@DESCRIPTION: Machine configuration for sitec systems S4
#@MAINTAINER: Robert Lehmann <robert.lehmann@sitec-systems.de>

MACHINEOVERRIDES =. "mx6:mx6sx:"

require conf/machine/include/imx-base.inc
require conf/machine/include/tune-cortexa9.inc
require conf/machine/include/score-base.inc

KERNEL_DEVICETREE = "imx6sx-s4.dtb \
	imx6sx-s4-a4003.dtb"

UBOOT_CONFIG ??= "score"

PREFERRED_PROVIDER_virtual/kernel = "linux-sitec"
PREFERRED_PROVIDER_u-boot = "u-boot-imx"
PREFERRED_PROVIDER_virtual/bootloader = "u-boot-imx"
PREFERRED_VERSION_u-boot-imx = "2015.04"

IMAGE_FSTYPES += "ubifs"
MKUBIFS_ARGS = " --min-io-size 4096 --leb-size 253952 --max-leb-cnt 1962"
UBINIZE_ARGS = " --min-io-size 4096 --peb-size 262144 --sub-page-size 4096"
```
